`timescale 1ns / 1ps
`default_nettype none

// Clean Intan RHD SPI acquisition engine.
//
// Electrical contract:
//   * 80 spi_clk cycles per 16-bit transaction.
//   * CPOL=0, CPHA=0, MSB first.
//   * 64 bit-transfer cycles, 2 post-bit CS-low cycles, then 14 CS-high cycles.
//   * one 35-command logical scan: CONVERT(0..31), AUX1, AUX2, AUX3.
//
// The logical data contract is intentionally versioned. Replies are tagged
// through the RHD two-command pipeline and emitted as CH0..31 followed by the
// AUX1..3 replies generated by the same logical scan.  The first two stale
// replies after START are discarded and a normal STOP issues two READ(63)
// drain transactions so the final AUX replies are not lost.
module spi_intan_interface_4_bank (
    input  wire        s00_axi_aclk,
    input  wire        spi_clk,
    input  wire        reset,
    input  wire        system_reset_spi,
    input  wire        spi_domain_reset,
    input  wire        spi_domain_reset_request_bus,

    input  wire        acquisition_start_request,
    output reg         acquisition_start_acknowledge,
    output wire        configuration_locked,

    input  wire        run_continuous,
    input  wire        dsp_settle,
    input  wire        init_dummy_mode,
    input  wire [31:0] finite_frame_count,
    input  wire [31:0] miso_phase_primary,
    input  wire [31:0] miso_phase_secondary,
    input  wire [15:0] logical_stream_enable,
    input  wire        compute_output_enable,
    input  wire        recording_output_enable,
    input  wire [ 7:0] aux1_bank_select,
    input  wire [ 7:0] aux2_bank_select,
    input  wire [ 7:0] aux3_bank_select,
    input  wire [ 9:0] aux1_end_index,
    input  wire [ 9:0] aux2_end_index,
    input  wire [ 9:0] aux3_end_index,
    input  wire [ 9:0] aux1_loop_index,
    input  wire [ 9:0] aux2_loop_index,
    input  wire [ 9:0] aux3_loop_index,
    input  wire        fast_settle_enable,
    input  wire [ 3:0] fast_settle_ttl_input_index,
    input  wire [ 1:0] sync_mode,
    input  wire [15:0] sync_period_frames,
    input  wire [15:0] sync_high_frames,

    input  wire [ 1:0] aux1_bus_write_strobe,
    input  wire [11:0] aux1_bus_address,
    input  wire [15:0] aux1_bus_write_data,
    output wire [15:0] aux1_bus_read_data,
    input  wire [ 1:0] aux2_bus_write_strobe,
    input  wire [11:0] aux2_bus_address,
    input  wire [15:0] aux2_bus_write_data,
    output wire [15:0] aux2_bus_read_data,
    input  wire [ 1:0] aux3_bus_write_strobe,
    input  wire [11:0] aux3_bus_address,
    input  wire [15:0] aux3_bus_write_data,
    output wire [15:0] aux3_bus_read_data,

    input  wire        MISO_A1,
    input  wire        MISO_A2,
    input  wire        MISO_B1,
    input  wire        MISO_B2,
    input  wire        MISO_C1,
    input  wire        MISO_C2,
    input  wire        MISO_D1,
    input  wire        MISO_D2,

    output reg         SPI_running,
    output reg         SCLK,
    output reg         CS,
    output reg         MOSI_A,
    output reg         MOSI_B,
    output reg         MOSI_C,
    output reg         MOSI_D,
    output wire        intan_sync_out,

    output wire [15:0] raw_frame_word,
    output wire        raw_frame_word_valid,
    output wire        raw_frame_word_last,
    output reg         acquisition_session_end,

    output wire        session_compute_output_enable,
    output wire        session_recording_output_enable,

    input  wire [ 1:0] ttl_in_external,
    input  wire        intan_marker_active,
    input  wire [13:0] intan_marker_mask
);
    localparam [15:0] READ_REGISTER_63 = 16'hFF00;
    localparam [15:0] FAST_SETTLE_ON_COMMAND  = 16'h80FE;
    localparam [15:0] FAST_SETTLE_OFF_COMMAND = 16'h80DE;

    localparam [5:0] SCAN_SLOT_FIRST_CHANNEL = 6'd0;
    localparam [5:0] SCAN_SLOT_LAST_CHANNEL  = 6'd31;
    localparam [5:0] SCAN_SLOT_AUX1          = 6'd32;
    localparam [5:0] SCAN_SLOT_AUX2          = 6'd33;
    localparam [5:0] SCAN_SLOT_AUX3          = 6'd34;

    localparam [1:0] CONNECTOR_A = 2'd0;
    localparam [1:0] CONNECTOR_B = 2'd1;
    localparam [1:0] CONNECTOR_C = 2'd2;
    localparam [1:0] CONNECTOR_D = 2'd3;

    localparam [6:0] SPI_CYCLE_FIRST              = 7'd0;
    localparam [6:0] SPI_CYCLE_LAST               = 7'd79;
    localparam [6:0] SPI_DATA_CYCLE_COUNT         = 7'd64;
    localparam [6:0] SPI_CS_DEASSERT_CYCLE        = 7'd66;
    localparam [6:0] MISO_CAPTURE_FIRST_CYCLE     = 7'd1;
    localparam [6:0] MISO_CAPTURE_LAST_CYCLE      = 7'd76;
    localparam [6:0] AUX_ADDRESS_FIRST_CYCLE      = 7'd64;
    localparam [6:0] AUX_ADDRESS_LAST_CYCLE       = 7'd67;
    localparam [6:0] AUX_CAPTURE_FIRST_CYCLE      = 7'd66;
    localparam [6:0] AUX_CAPTURE_LAST_CYCLE       = 7'd69;

    wire spi_running_bus;
    xpm_cdc_single #(
        .DEST_SYNC_FF(4),
        .INIT_SYNC_FF(1),
        .SIM_ASSERT_CHK(0),
        .SRC_INPUT_REG(1)
    ) u_running_to_bus (
        .src_clk(spi_clk),
        .src_in(SPI_running),
        .dest_clk(s00_axi_aclk),
        .dest_out(spi_running_bus)
    );

    // The upper clock manager asserts this reset before gating or
    // reprogramming spi_clk and releases it synchronously after restart.
    wire spi_reset = spi_domain_reset;

    // Bundle START with one coherent snapshot of every stopped-only setting.
    // The payload is registered one bus cycle before a request toggle and held
    // unchanged until the returned acknowledgement toggle matches.  In the SPI
    // domain, wait two extra cycles after the synchronized request before
    // latching the four-stage synchronized payload and producing START.
    // Both output enables are part of this same snapshot; there is no
    // independent running-edge sampler and no START-window coherence exception.
    localparam integer CONFIG_WIDTH = 253;
    localparam integer START_REQUEST_SYNC_STAGES = 4;
    localparam integer START_RESET_REALIGN_CYCLES =
        START_REQUEST_SYNC_STAGES + 1;
    localparam integer START_RESET_REALIGN_WIDTH =
        $clog2(START_RESET_REALIGN_CYCLES + 1);
    wire [CONFIG_WIDTH-1:0] config_bus = {
        intan_marker_mask,
        sync_high_frames, sync_period_frames, sync_mode,
        miso_phase_secondary,
        fast_settle_ttl_input_index, fast_settle_enable,
        recording_output_enable, compute_output_enable, logical_stream_enable,
        aux3_loop_index, aux2_loop_index, aux1_loop_index,
        aux3_end_index, aux2_end_index, aux1_end_index,
        aux3_bank_select, aux2_bank_select, aux1_bank_select,
        miso_phase_primary, finite_frame_count,
        init_dummy_mode, dsp_settle
    };
    reg [CONFIG_WIDTH-1:0] config_start_payload_bus = {CONFIG_WIDTH{1'b0}};
    reg config_start_launch_pending_bus = 1'b0;
    reg config_start_request_toggle_bus = 1'b0;
    reg config_start_request_inflight_bus = 1'b0;
    wire config_start_ack_toggle_bus;
    wire config_start_accept_toggle_bus;
    reg config_start_accept_toggle_seen_bus = 1'b0;
    reg config_start_accept_wait_running_bus = 1'b0;
    wire spi_reset_bus = spi_domain_reset_request_bus;

    assign configuration_locked = spi_running_bus ||
                                  config_start_launch_pending_bus ||
                                  config_start_request_inflight_bus ||
                                  acquisition_start_acknowledge ||
                                  config_start_accept_wait_running_bus;

    always @(posedge s00_axi_aclk) begin
        if (reset) begin
            config_start_payload_bus <= {CONFIG_WIDTH{1'b0}};
            config_start_launch_pending_bus <= 1'b0;
            config_start_request_toggle_bus <= 1'b0;
            config_start_request_inflight_bus <= 1'b0;
            config_start_accept_toggle_seen_bus <= 1'b0;
            config_start_accept_wait_running_bus <= 1'b0;
            acquisition_start_acknowledge <= 1'b0;
        end else if (config_start_request_inflight_bus) begin
            // The transport-return toggle can mean either destination capture
            // or reset cancellation.  A live request remains owned until the
            // independent accepted-event toggle returns.  Once a clock error
            // cancels the bank request, the transport return releases it.
            if (!acquisition_start_request &&
                (config_start_ack_toggle_bus ==
                 config_start_request_toggle_bus))
                config_start_request_inflight_bus <= 1'b0;
        end else if (config_start_launch_pending_bus) begin
            // The payload was registered on the preceding bus edge.
            config_start_request_toggle_bus <=
                !config_start_request_toggle_bus;
            config_start_request_inflight_bus <= 1'b1;
            config_start_launch_pending_bus <= 1'b0;
        end else if (!acquisition_start_acknowledge &&
                     acquisition_start_request &&
                     !spi_running_bus &&
                     (config_start_ack_toggle_bus ==
                      config_start_request_toggle_bus)) begin
            config_start_payload_bus <= config_bus;
            config_start_launch_pending_bus <= 1'b1;
        end

        // The request-return toggle above also changes when a destination reset
        // cancels an in-flight transfer.  Only this independent event toggle
        // means that the SPI domain captured the payload and produced START.
        if (!reset) begin
            if (config_start_accept_toggle_bus !=
                config_start_accept_toggle_seen_bus) begin
                config_start_accept_toggle_seen_bus <=
                    config_start_accept_toggle_bus;
                config_start_request_inflight_bus <= 1'b0;
                if (acquisition_start_request) begin
                    acquisition_start_acknowledge <= 1'b1;
                    config_start_accept_wait_running_bus <= 1'b1;
                end
            end

            if (!acquisition_start_request)
                acquisition_start_acknowledge <= 1'b0;

            // Keep stopped-only configuration locked until the separately
            // synchronized RUNNING level catches up with acceptance. A later
            // destination reset cancels the tail if RUNNING never arrives.
            if (spi_running_bus || spi_reset_bus)
                config_start_accept_wait_running_bus <= 1'b0;
        end
    end

    wire [CONFIG_WIDTH-1:0] config_payload_sync_spi;
    xpm_cdc_array_single #(
        .DEST_SYNC_FF(4),
        .INIT_SYNC_FF(1),
        .SIM_ASSERT_CHK(0),
        .SRC_INPUT_REG(0),
        .WIDTH(CONFIG_WIDTH)
    ) u_start_config_payload_cdc (
        .src_clk(s00_axi_aclk),
        .src_in(config_start_payload_bus),
        .dest_clk(spi_clk),
        .dest_out(config_payload_sync_spi)
    );

    wire config_start_request_toggle_spi;
    xpm_cdc_single #(
        .DEST_SYNC_FF(START_REQUEST_SYNC_STAGES),
        .INIT_SYNC_FF(1),
        .SIM_ASSERT_CHK(0),
        .SRC_INPUT_REG(0)
    ) u_start_config_request_cdc (
        .src_clk(s00_axi_aclk),
        .src_in(config_start_request_toggle_bus),
        .dest_clk(spi_clk),
        .dest_out(config_start_request_toggle_spi)
    );

    reg [CONFIG_WIDTH-1:0] config_spi = {CONFIG_WIDTH{1'b0}};
    reg config_start_ack_toggle_spi = 1'b0;
    reg config_start_accept_toggle_spi = 1'b0;
    reg config_capture_pending_spi = 1'b0;
    reg [1:0] config_capture_delay_spi = 2'd0;
    reg start_pulse_spi = 1'b0;
    reg [START_RESET_REALIGN_WIDTH-1:0]
        start_reset_realign_count_spi = START_RESET_REALIGN_CYCLES;

    always @(posedge spi_clk) begin
        start_pulse_spi <= 1'b0;
        if (spi_reset) begin
            config_spi <= {CONFIG_WIDTH{1'b0}};
            // Cancel any pre-reset transaction and align the destination
            // history with the synchronized source level.  Resetting this
            // toggle to a constant would replay every odd-numbered completed
            // START after a later clock-domain reset.
            config_start_ack_toggle_spi <=
                config_start_request_toggle_spi;
            config_capture_pending_spi <= 1'b0;
            config_capture_delay_spi <= 2'd0;
            start_reset_realign_count_spi <= START_RESET_REALIGN_CYCLES;
        end else if (start_reset_realign_count_spi != 0) begin
            // A domain reset cancels every START that predates it. Keep
            // following the request through the complete synchronizer latency
            // so an in-flight toggle cannot appear as a new post-reset START.
            config_start_ack_toggle_spi <=
                config_start_request_toggle_spi;
            config_capture_pending_spi <= 1'b0;
            config_capture_delay_spi <= 2'd0;
            start_reset_realign_count_spi <=
                start_reset_realign_count_spi - 1'b1;
        end else if (!config_capture_pending_spi) begin
            if (config_start_request_toggle_spi !=
                config_start_ack_toggle_spi) begin
                config_capture_pending_spi <= 1'b1;
                config_capture_delay_spi <= 2'd2;
            end
        end else if (config_capture_delay_spi > 2'd1) begin
            config_capture_delay_spi <= config_capture_delay_spi - 2'd1;
        end else begin
            config_spi <= config_payload_sync_spi;
            start_pulse_spi <= 1'b1;
            config_start_ack_toggle_spi <=
                config_start_request_toggle_spi;
            config_capture_pending_spi <= 1'b0;
            config_capture_delay_spi <= 2'd0;
        end
    end

    xpm_cdc_single #(
        .DEST_SYNC_FF(4),
        .INIT_SYNC_FF(1),
        .SIM_ASSERT_CHK(0),
        .SRC_INPUT_REG(0)
    ) u_start_config_ack_cdc (
        .src_clk(spi_clk),
        .src_in(config_start_ack_toggle_spi),
        .dest_clk(s00_axi_aclk),
        .dest_out(config_start_ack_toggle_bus)
    );

    xpm_cdc_single #(
        .DEST_SYNC_FF(4),
        .INIT_SYNC_FF(1),
        .SIM_ASSERT_CHK(0),
        .SRC_INPUT_REG(0)
    ) u_start_config_accept_cdc (
        .src_clk(spi_clk),
        .src_in(config_start_accept_toggle_spi),
        .dest_clk(s00_axi_aclk),
        .dest_out(config_start_accept_toggle_bus)
    );

    // Unlike the stopped-only payload, RUN_CONTINUOUS remains a live
    // frame-boundary stop request.  Cross it independently as a single level.
    wire run_continuous_spi;
    xpm_cdc_single #(
        .DEST_SYNC_FF(4),
        .INIT_SYNC_FF(1),
        .SIM_ASSERT_CHK(0),
        .SRC_INPUT_REG(1)
    ) u_run_continuous_cdc (
        .src_clk(s00_axi_aclk),
        .src_in(run_continuous),
        .dest_clk(spi_clk),
        .dest_out(run_continuous_spi)
    );

    wire dsp_settle_spi = config_spi[0];
    wire init_dummy_mode_spi = config_spi[1];
    wire [31:0] finite_frame_count_spi = config_spi[33:2];
    wire [31:0] miso_phase_primary_spi = config_spi[65:34];
    wire [7:0] aux1_banks_spi = config_spi[73:66];
    wire [7:0] aux2_banks_spi = config_spi[81:74];
    wire [7:0] aux3_banks_spi = config_spi[89:82];
    wire [9:0] aux1_end_spi = config_spi[99:90];
    wire [9:0] aux2_end_spi = config_spi[109:100];
    wire [9:0] aux3_end_spi = config_spi[119:110];
    wire [9:0] aux1_loop_spi = config_spi[129:120];
    wire [9:0] aux2_loop_spi = config_spi[139:130];
    wire [9:0] aux3_loop_spi = config_spi[149:140];
    wire [15:0] stream_enable_spi = config_spi[165:150];
    wire compute_output_enable_spi = config_spi[166];
    wire recording_output_enable_spi = config_spi[167];
    wire ttl_settle_enable_spi = config_spi[168];
    wire [3:0] ttl_settle_input_index_spi = config_spi[172:169];
    wire [31:0] miso_phase_secondary_spi = config_spi[204:173];
    wire [1:0] sync_mode_spi = config_spi[206:205];
    wire [15:0] sync_period_frames_spi = config_spi[222:207];
    wire [15:0] sync_high_frames_spi = config_spi[238:223];
    wire [13:0] marker_mask_spi = config_spi[252:239];

    // All stopped-only configuration is snapshotted at START.  This makes
    // frame length, stream identities, command schedules, and phase selection
    // immutable for the complete acquisition session.  run_continuous_spi is
    // intentionally not latched: clearing it is the live, frame-boundary STOP
    // request used by firmware.
    reg        session_dsp_settle;
    reg        session_init_dummy_mode;
    reg [31:0] session_finite_frame_count;
    reg [31:0] session_miso_phase_primary;
    reg [31:0] session_miso_phase_secondary;
    reg [ 7:0] session_aux1_banks, session_aux2_banks, session_aux3_banks;
    reg [ 9:0] session_aux1_end, session_aux2_end, session_aux3_end;
    reg [ 9:0] session_aux1_loop, session_aux2_loop, session_aux3_loop;
    reg [15:0] session_stream_mask;
    reg        session_compute_output_enable_r;
    reg        session_recording_output_enable_r;
    reg        session_ttl_settle_enable;
    reg [ 3:0] session_ttl_settle_input_index;
    reg [13:0] session_marker_mask;
    assign session_compute_output_enable = session_compute_output_enable_r;
    assign session_recording_output_enable = session_recording_output_enable_r;

    // ---------------------------------------------------------------------
    // Inferred synchronous AUX command memories.
    // ---------------------------------------------------------------------
    reg [11:0] aux1_read_address, aux2_read_address, aux3_read_address;
    wire [15:0] aux1_read_data, aux2_read_data, aux3_read_data;
    intan_aux_command_ram u_aux1_ram (
        .bus_clk(s00_axi_aclk), .bus_write_strobe(aux1_bus_write_strobe),
        .bus_address(aux1_bus_address), .bus_write_data(aux1_bus_write_data),
        .bus_read_data(aux1_bus_read_data),
        .read_clk(spi_clk), .read_reset(spi_reset), .read_address(aux1_read_address), .read_data(aux1_read_data));
    intan_aux_command_ram u_aux2_ram (
        .bus_clk(s00_axi_aclk), .bus_write_strobe(aux2_bus_write_strobe),
        .bus_address(aux2_bus_address), .bus_write_data(aux2_bus_write_data),
        .bus_read_data(aux2_bus_read_data),
        .read_clk(spi_clk), .read_reset(spi_reset), .read_address(aux2_read_address), .read_data(aux2_read_data));
    intan_aux_command_ram u_aux3_ram (
        .bus_clk(s00_axi_aclk), .bus_write_strobe(aux3_bus_write_strobe),
        .bus_address(aux3_bus_address), .bus_write_data(aux3_bus_write_data),
        .bus_read_data(aux3_bus_read_data),
        .read_clk(spi_clk), .read_reset(spi_reset), .read_address(aux3_read_address), .read_data(aux3_read_data));

    // ---------------------------------------------------------------------
    // Physical transaction engine.
    // ---------------------------------------------------------------------
    typedef enum logic [2:0] {
        ENGINE_IDLE,
        ENGINE_SCAN,
        ENGINE_DRAIN_AUX2,
        ENGINE_DRAIN_AUX3,
        ENGINE_FINALIZE,
        ENGINE_WAIT_OUTPUT
    } engine_state_t;

    engine_state_t engine_state;
    reg [6:0] spi_cycle;
    reg [5:0] scan_slot;
    reg [31:0] frame_timestamp;
    reg [15:0] current_command_a;
    reg [15:0] current_command_b;
    reg [15:0] current_command_c;
    reg [15:0] current_command_d;
    reg [9:0] aux1_index, aux2_index, aux3_index;
    reg [15:0] aux1_prefetch [0:3];
    reg [15:0] aux2_prefetch [0:3];
    reg [15:0] aux3_prefetch [0:3];

    wire physical_transaction_active = (engine_state == ENGINE_SCAN) ||
                                       (engine_state == ENGINE_DRAIN_AUX2) ||
                                       (engine_state == ENGINE_DRAIN_AUX3);
    // The bus domain admits START only while the clock manager is ready,
    // locked, and error-free, then transfers that accepted request and its
    // configuration atomically. Do not re-sample those bus-domain status bits
    // here: later lock loss is owned by spi_reset, while a direct status check
    // would create an unsafe control CDC into every session-state register.
    wire start_session_accept = start_pulse_spi &&
                                engine_state == ENGINE_IDLE &&
                                stream_enable_spi != 16'd0;

    // This event is deliberately not re-aligned on a sample-clock-domain
    // reset. Unlike config_start_ack_toggle_spi, it denotes only an actual
    // engine acceptance, never reset cancellation. The asynchronous global
    // reset prevents an accepted event from replaying after system reset even
    // when the generated clock is stopped.
    always @(posedge spi_clk or posedge system_reset_spi) begin
        if (system_reset_spi) begin
            config_start_accept_toggle_spi <= 1'b0;
        end else if (!spi_reset && start_session_accept) begin
            config_start_accept_toggle_spi <=
                !config_start_accept_toggle_spi;
        end
    end

    wire [6:0] next_spi_cycle = spi_cycle + 7'd1;
    wire [4:0] next_mosi_bit_index = (next_spi_cycle < SPI_DATA_CYCLE_COUNT) ?
                                      (5'd15 - next_spi_cycle[6:2]) : 5'd0;

    reg [75:0] miso_samples [0:7];
    wire [255:0] aligned_words;
    intan_miso_aligner_8lane u_miso_aligner (
        .primary_phases(session_miso_phase_primary),
        .secondary_phases(session_miso_phase_secondary),
        .samples_a1(miso_samples[0]), .samples_a2(miso_samples[1]),
        .samples_b1(miso_samples[2]), .samples_b2(miso_samples[3]),
        .samples_c1(miso_samples[4]), .samples_c2(miso_samples[5]),
        .samples_d1(miso_samples[6]), .samples_d2(miso_samples[7]),
        .aligned_words(aligned_words));

    // RHD replies arrive two commands after issue.  These names describe the
    // role of each metadata stage instead of exposing an unexplained tag 0/1/2
    // shift register.  At the next transaction boundary, returning_reply_meta
    // labels the fully captured aligned_words value.
    typedef struct packed {
        logic        reply_expected;
        logic [ 5:0] slot;
        logic [31:0] timestamp;
        logic [15:0] ttl_snapshot;
    } reply_meta_t;
    reply_meta_t issued_command_meta;
    reply_meta_t one_command_delay_meta;
    reply_meta_t returning_reply_meta;

    // The two physical TTL inputs are independent asynchronous levels.  The
    // fourteen-bit stimulation mask is part of the coherent START snapshot;
    // only its one-bit active qualifier crosses live.  This prevents fourteen
    // independently synchronized marker bits from producing torn patterns.
    wire [1:0] ttl_external_spi_sync;
    xpm_cdc_array_single #(
        .DEST_SYNC_FF  (2),
        .INIT_SYNC_FF  (1),
        .SIM_ASSERT_CHK(0),
        .SRC_INPUT_REG (0),
        .WIDTH         (2)
    ) u_external_ttl_to_spi (
        .src_clk (s00_axi_aclk), // ignored when SRC_INPUT_REG=0
        .src_in  (ttl_in_external),
        .dest_clk(spi_clk),
        .dest_out(ttl_external_spi_sync)
    );

    wire marker_active_spi;
    xpm_cdc_single #(
        .DEST_SYNC_FF(2),
        .INIT_SYNC_FF(1),
        .SIM_ASSERT_CHK(0),
        .SRC_INPUT_REG(0)
    ) u_marker_active_to_spi (
        .src_clk(s00_axi_aclk),
        .src_in(intan_marker_active),
        .dest_clk(spi_clk),
        .dest_out(marker_active_spi)
    );

    wire [15:0] ttl_spi_sync = {
        marker_active_spi ? session_marker_mask : 14'd0,
        ttl_external_spi_sync
    };

    reg [15:0] ttl_for_frame;
    reg settle_level;
    reg settle_control_enabled;
    reg settle_overlay_pending;
    reg settle_overlay_value;
    reg settle_frame_override;

    wire requested_settle_level = session_ttl_settle_enable &&
        ttl_spi_sync[session_ttl_settle_input_index];
    wire settle_control_changed =
        (session_ttl_settle_enable != settle_control_enabled);
    wire settle_input_changed = session_ttl_settle_enable &&
        (requested_settle_level != settle_level);
    wire settle_update_requested = settle_control_changed || settle_input_changed;
    wire settle_override_required = session_ttl_settle_enable ||
        settle_overlay_pending || settle_update_requested;

    function automatic [15:0] build_convert_command(
        input [5:0] channel_number,
        input       dsp_settle_value
    );
        begin
            build_convert_command = {
                2'b00, channel_number, 7'b0000000, dsp_settle_value
            };
        end
    endfunction

    function automatic [15:0] apply_fast_settle_override(
        input [15:0] command_word,
        input        override_enable,
        input        override_value
    );
        begin
            if (override_enable && command_word[15:8] == 8'h80)
                apply_fast_settle_override = {
                    command_word[15:6], override_value, command_word[4:0]
                };
            else
                apply_fast_settle_override = command_word;
        end
    endfunction

    function automatic [15:0] build_scan_command(
        input [5:0] scan_slot_number,
        input       init_dummy_mode,
        input       dsp_settle_value,
        input [15:0] aux1_word,
        input [15:0] aux2_word,
        input [15:0] aux3_word,
        input        overlay_pending,
        input        overlay_value,
        input        frame_override,
        input        settle_level_value
    );
        begin
            build_scan_command = READ_REGISTER_63;

            if (scan_slot_number <= SCAN_SLOT_LAST_CHANNEL) begin
                build_scan_command = init_dummy_mode ?
                    READ_REGISTER_63 :
                    build_convert_command(scan_slot_number, dsp_settle_value);
            end else begin
                case (scan_slot_number)
                    SCAN_SLOT_AUX1: begin
                        if (!init_dummy_mode) begin
                            build_scan_command = overlay_pending ?
                                (overlay_value ?
                                    FAST_SETTLE_ON_COMMAND : FAST_SETTLE_OFF_COMMAND) :
                                apply_fast_settle_override(
                                    aux1_word, frame_override, settle_level_value);
                        end
                    end
                    SCAN_SLOT_AUX2: begin
                        if (!init_dummy_mode)
                            build_scan_command = apply_fast_settle_override(
                                aux2_word, frame_override, settle_level_value);
                    end
                    SCAN_SLOT_AUX3: begin
                        build_scan_command = apply_fast_settle_override(
                            aux3_word, frame_override, settle_level_value);
                    end
                    default: build_scan_command = READ_REGISTER_63;
                endcase
            end
        end
    endfunction

    function automatic [9:0] advance_aux_index(
        input [9:0] current_index,
        input [9:0] end_index,
        input [9:0] loop_index
    );
        begin
            advance_aux_index = (current_index >= end_index) ?
                loop_index : current_index + 10'd1;
        end
    endfunction

    // The START edge enters scan slot 0 before the session registers have
    // latched.  Name the complete first command explicitly instead of relying
    // on init_dummy_mode_spi coincidentally matching that command's MSB.
    wire [15:0] start_scan_command = init_dummy_mode_spi ?
        READ_REGISTER_63 :
        build_convert_command(SCAN_SLOT_FIRST_CHANNEL, dsp_settle_spi);
    wire [15:0] next_frame_first_command = session_init_dummy_mode ?
        READ_REGISTER_63 :
        build_convert_command(SCAN_SLOT_FIRST_CHANNEL, session_dsp_settle);

    wire [5:0] following_scan_slot = scan_slot + 6'd1;
    wire [15:0] following_scan_command_a =
        build_scan_command(
            following_scan_slot, session_init_dummy_mode, session_dsp_settle,
            aux1_prefetch[CONNECTOR_A], aux2_prefetch[CONNECTOR_A],
            aux3_prefetch[CONNECTOR_A], settle_overlay_pending,
            settle_overlay_value, settle_frame_override, settle_level);
    wire [15:0] following_scan_command_b =
        build_scan_command(
            following_scan_slot, session_init_dummy_mode, session_dsp_settle,
            aux1_prefetch[CONNECTOR_B], aux2_prefetch[CONNECTOR_B],
            aux3_prefetch[CONNECTOR_B], settle_overlay_pending,
            settle_overlay_value, settle_frame_override, settle_level);
    wire [15:0] following_scan_command_c =
        build_scan_command(
            following_scan_slot, session_init_dummy_mode, session_dsp_settle,
            aux1_prefetch[CONNECTOR_C], aux2_prefetch[CONNECTOR_C],
            aux3_prefetch[CONNECTOR_C], settle_overlay_pending,
            settle_overlay_value, settle_frame_override, settle_level);
    wire [15:0] following_scan_command_d =
        build_scan_command(
            following_scan_slot, session_init_dummy_mode, session_dsp_settle,
            aux1_prefetch[CONNECTOR_D], aux2_prefetch[CONNECTOR_D],
            aux3_prefetch[CONNECTOR_D], settle_overlay_pending,
            settle_overlay_value, settle_frame_override, settle_level);

    // FINITE_FRAME_COUNT=N emits timestamps 0..N-1.  Zero is rejected unless
    // continuous mode is selected; continuous mode ignores the finite limit
    // until software clears ACQUISITION_CONFIG.CONTINUOUS.
    wire another_frame_requested = run_continuous_spi ||
        ((session_finite_frame_count != 32'd0) &&
         ((frame_timestamp + 32'd1) < session_finite_frame_count));

    // Exact logical-sample boundaries.  start_session_accept launches the first
    // slot-0 command.  The AUX3 cycle-79 wrap edge launches each later slot-0
    // command.  The complementary terminal edge ends recording before the two
    // response-pipeline drain transactions.
    wire sync_frame_advance =
        (engine_state == ENGINE_SCAN) &&
        (scan_slot == SCAN_SLOT_AUX3) &&
        (spi_cycle == SPI_CYCLE_LAST) &&
        another_frame_requested;
    wire sync_session_stop =
        (engine_state == ENGINE_SCAN) &&
        (scan_slot == SCAN_SLOT_AUX3) &&
        (spi_cycle == SPI_CYCLE_LAST) &&
        !another_frame_requested;

    intan_sync_generator u_intan_sync_generator (
        .spi_clk              (spi_clk),
        .reset                (spi_reset),
        .session_start        (start_session_accept),
        .frame_advance        (sync_frame_advance),
        .session_stop         (sync_session_stop),
        .config_mode          (sync_mode_spi),
        .config_period_frames(sync_period_frames_spi),
        .config_high_frames  (sync_high_frames_spi),
        .sync_out_spi         (intan_sync_out)
    );

    // Commands selected for cycle zero of the next physical transaction.
    // These signals are sampled only by the pin-output flops at the cycle-79
    // boundary.  Keeping the decode before the registers removes counter-
    // decode glitches from the external pins without changing the waveform.
    reg [15:0] next_transaction_command_a;
    reg [15:0] next_transaction_command_b;
    reg [15:0] next_transaction_command_c;
    reg [15:0] next_transaction_command_d;
    reg        next_transaction_valid;

    always @* begin
        next_transaction_valid = 1'b0;
        next_transaction_command_a = 16'd0;
        next_transaction_command_b = 16'd0;
        next_transaction_command_c = 16'd0;
        next_transaction_command_d = 16'd0;

        case (engine_state)
            ENGINE_SCAN: begin
                if (scan_slot < SCAN_SLOT_AUX3) begin
                    next_transaction_valid = 1'b1;
                    next_transaction_command_a = following_scan_command_a;
                    next_transaction_command_b = following_scan_command_b;
                    next_transaction_command_c = following_scan_command_c;
                    next_transaction_command_d = following_scan_command_d;
                end else if (scan_slot == SCAN_SLOT_AUX3) begin
                    next_transaction_valid = 1'b1;
                    if (another_frame_requested) begin
                        next_transaction_command_a = next_frame_first_command;
                        next_transaction_command_b = next_frame_first_command;
                        next_transaction_command_c = next_frame_first_command;
                        next_transaction_command_d = next_frame_first_command;
                    end else begin
                        // First benign transaction exposes the final AUX2 reply.
                        next_transaction_command_a = READ_REGISTER_63;
                        next_transaction_command_b = READ_REGISTER_63;
                        next_transaction_command_c = READ_REGISTER_63;
                        next_transaction_command_d = READ_REGISTER_63;
                    end
                end
            end

            ENGINE_DRAIN_AUX2: begin
                // Second benign transaction exposes the final AUX3 reply.
                next_transaction_valid = 1'b1;
                next_transaction_command_a = READ_REGISTER_63;
                next_transaction_command_b = READ_REGISTER_63;
                next_transaction_command_c = READ_REGISTER_63;
                next_transaction_command_d = READ_REGISTER_63;
            end

            ENGINE_DRAIN_AUX3: begin
                // AUX3 has now returned; keep the physical interface idle.
                next_transaction_valid = 1'b0;
            end

            default: begin
                next_transaction_valid = 1'b0;
            end
        endcase
    end

    // Register every external SPI output.  Values correspond to the state
    // that the transaction engine enters after this same rising edge, so the
    // established cycle contract remains CS-low 0..65, CS-high 66..79, with
    // SCLK high on cycles 4*n+2 and 4*n+3 and MOSI MSB-first on cycles 0..63.
    always @(posedge spi_clk) begin
        if (spi_reset) begin
            CS <= 1'b1;
            SCLK <= 1'b0;
            MOSI_A <= 1'b0;
            MOSI_B <= 1'b0;
            MOSI_C <= 1'b0;
            MOSI_D <= 1'b0;
        end else if (start_session_accept) begin
            CS <= 1'b0;
            SCLK <= 1'b0;
            MOSI_A <= start_scan_command[15];
            MOSI_B <= start_scan_command[15];
            MOSI_C <= start_scan_command[15];
            MOSI_D <= start_scan_command[15];
        end else if (physical_transaction_active) begin
            if (spi_cycle == SPI_CYCLE_LAST) begin
                CS <= !next_transaction_valid;
                SCLK <= 1'b0;
                MOSI_A <= next_transaction_valid ? next_transaction_command_a[15] : 1'b0;
                MOSI_B <= next_transaction_valid ? next_transaction_command_b[15] : 1'b0;
                MOSI_C <= next_transaction_valid ? next_transaction_command_c[15] : 1'b0;
                MOSI_D <= next_transaction_valid ? next_transaction_command_d[15] : 1'b0;
            end else begin
                CS <= (next_spi_cycle >= SPI_CS_DEASSERT_CYCLE);
                SCLK <= (next_spi_cycle < SPI_DATA_CYCLE_COUNT) && next_spi_cycle[1];
                MOSI_A <= (next_spi_cycle < SPI_DATA_CYCLE_COUNT) ?
                    current_command_a[next_mosi_bit_index] : 1'b0;
                MOSI_B <= (next_spi_cycle < SPI_DATA_CYCLE_COUNT) ?
                    current_command_b[next_mosi_bit_index] : 1'b0;
                MOSI_C <= (next_spi_cycle < SPI_DATA_CYCLE_COUNT) ?
                    current_command_c[next_mosi_bit_index] : 1'b0;
                MOSI_D <= (next_spi_cycle < SPI_DATA_CYCLE_COUNT) ?
                    current_command_d[next_mosi_bit_index] : 1'b0;
            end
        end else begin
            CS <= 1'b1;
            SCLK <= 1'b0;
            MOSI_A <= 1'b0;
            MOSI_B <= 1'b0;
            MOSI_C <= 1'b0;
            MOSI_D <= 1'b0;
        end
    end

    // Metadata pipeline for the RHD two-command response latency.  Drain
    // commands advance the pipeline but set reply_expected=0 for themselves;
    // their purpose is only to expose the pending AUX2/AUX3 replies.
    always @(posedge spi_clk) begin
        if (spi_reset || start_session_accept) begin
            issued_command_meta <= '0;
            one_command_delay_meta <= '0;
            returning_reply_meta <= '0;
        end else if (physical_transaction_active && spi_cycle == SPI_CYCLE_FIRST) begin
            returning_reply_meta <= one_command_delay_meta;
            one_command_delay_meta <= issued_command_meta;
            issued_command_meta.reply_expected <= (engine_state == ENGINE_SCAN);
            issued_command_meta.slot <= scan_slot;
            issued_command_meta.timestamp <= frame_timestamp;
            issued_command_meta.ttl_snapshot <=
                (engine_state == ENGINE_SCAN &&
                 scan_slot == SCAN_SLOT_FIRST_CHANNEL) ?
                ttl_spi_sync : ttl_for_frame;
        end
    end

    // ---------------------------------------------------------------------
    // Reply formatter boundary.  The physical engine produces one atomic
    // reply event; the formatter is the sole owner of compact serialization.
    // ---------------------------------------------------------------------
    wire reply_event_valid =
        (physical_transaction_active && spi_cycle == SPI_CYCLE_FIRST &&
         returning_reply_meta.reply_expected) ||
        (engine_state == ENGINE_FINALIZE &&
         returning_reply_meta.reply_expected);
    wire reply_event_is_final = (engine_state == ENGINE_FINALIZE);
    wire reply_event_ready;
    wire formatter_final_reply_done;

    intan_reply_formatter u_reply_formatter (
        .clk                  (spi_clk),
        .reset                (spi_reset),
        .session_stream_mask  (session_stream_mask),
        .reply_valid          (reply_event_valid),
        .reply_ready          (reply_event_ready),
        .reply_slot           (returning_reply_meta.slot),
        .reply_timestamp      (returning_reply_meta.timestamp),
        .reply_ttl            (returning_reply_meta.ttl_snapshot),
        .reply_words          (aligned_words),
        .reply_is_final       (reply_event_is_final),
        .final_reply_done     (formatter_final_reply_done),
        .raw_frame_word     (raw_frame_word),
        .raw_frame_word_valid (raw_frame_word_valid),
        .raw_frame_word_last(raw_frame_word_last)
    );

    // MISO sampling has one owner and no scheduler side effects.  Cycle 1 is
    // the established phase-0 origin; cycles 1..76 fill every selectable
    // sample[0..75] for the complete four-bit phase range.
    integer sample_lane;
    always @(posedge spi_clk) begin
        if (spi_reset) begin
            for (sample_lane = 0; sample_lane < 8; sample_lane = sample_lane + 1)
                miso_samples[sample_lane] <= 76'd0;
        end else if (physical_transaction_active &&
                     spi_cycle >= MISO_CAPTURE_FIRST_CYCLE &&
                     spi_cycle <= MISO_CAPTURE_LAST_CYCLE) begin
            miso_samples[0][spi_cycle-MISO_CAPTURE_FIRST_CYCLE] <= MISO_A1;
            miso_samples[1][spi_cycle-MISO_CAPTURE_FIRST_CYCLE] <= MISO_A2;
            miso_samples[2][spi_cycle-MISO_CAPTURE_FIRST_CYCLE] <= MISO_B1;
            miso_samples[3][spi_cycle-MISO_CAPTURE_FIRST_CYCLE] <= MISO_B2;
            miso_samples[4][spi_cycle-MISO_CAPTURE_FIRST_CYCLE] <= MISO_C1;
            miso_samples[5][spi_cycle-MISO_CAPTURE_FIRST_CYCLE] <= MISO_C2;
            miso_samples[6][spi_cycle-MISO_CAPTURE_FIRST_CYCLE] <= MISO_D1;
            miso_samples[7][spi_cycle-MISO_CAPTURE_FIRST_CYCLE] <= MISO_D2;
        end
    end

    // Session controller, command scheduler, and AUX prefetch.
    always @(posedge spi_clk) begin
        acquisition_session_end <= 1'b0;

        if (spi_reset) begin
            SPI_running <= 1'b0;
            engine_state <= ENGINE_IDLE;
            spi_cycle <= SPI_CYCLE_FIRST;
            scan_slot <= SCAN_SLOT_FIRST_CHANNEL;
            frame_timestamp <= 32'd0;
            current_command_a <= 16'd0;
            current_command_b <= 16'd0;
            current_command_c <= 16'd0;
            current_command_d <= 16'd0;
            aux1_index <= 10'd0;
            aux2_index <= 10'd0;
            aux3_index <= 10'd0;
            aux1_read_address <= 12'd0;
            aux2_read_address <= 12'd0;
            aux3_read_address <= 12'd0;
            session_dsp_settle <= 1'b0;
            session_init_dummy_mode <= 1'b0;
            session_finite_frame_count <= 32'd0;
            session_miso_phase_primary <= 32'd0;
            session_miso_phase_secondary <= 32'd0;
            session_aux1_banks <= 8'd0;
            session_aux2_banks <= 8'd0;
            session_aux3_banks <= 8'd0;
            session_aux1_end <= 10'd0;
            session_aux2_end <= 10'd0;
            session_aux3_end <= 10'd0;
            session_aux1_loop <= 10'd0;
            session_aux2_loop <= 10'd0;
            session_aux3_loop <= 10'd0;
            session_stream_mask <= 16'd0;
            session_compute_output_enable_r <= 1'b0;
            session_recording_output_enable_r <= 1'b0;
            session_ttl_settle_enable <= 1'b0;
            session_ttl_settle_input_index <= 4'd0;
            session_marker_mask <= 14'd0;
            ttl_for_frame <= 16'd0;
            settle_level <= 1'b0;
            settle_control_enabled <= 1'b0;
            settle_overlay_pending <= 1'b0;
            settle_overlay_value <= 1'b0;
            settle_frame_override <= 1'b0;
        end else begin
            if (start_session_accept) begin
                SPI_running <= 1'b1;
                engine_state <= ENGINE_SCAN;
                spi_cycle <= SPI_CYCLE_FIRST;
                scan_slot <= SCAN_SLOT_FIRST_CHANNEL;
                frame_timestamp <= 32'd0;
                current_command_a <= start_scan_command;
                current_command_b <= start_scan_command;
                current_command_c <= start_scan_command;
                current_command_d <= start_scan_command;
                aux1_index <= 10'd0;
                aux2_index <= 10'd0;
                aux3_index <= 10'd0;
                session_dsp_settle <= dsp_settle_spi;
                session_init_dummy_mode <= init_dummy_mode_spi;
                session_finite_frame_count <= finite_frame_count_spi;
                session_miso_phase_primary <= miso_phase_primary_spi;
                session_miso_phase_secondary <= miso_phase_secondary_spi;
                session_aux1_banks <= aux1_banks_spi;
                session_aux2_banks <= aux2_banks_spi;
                session_aux3_banks <= aux3_banks_spi;
                session_aux1_end <= aux1_end_spi;
                session_aux2_end <= aux2_end_spi;
                session_aux3_end <= aux3_end_spi;
                session_aux1_loop <= aux1_loop_spi;
                session_aux2_loop <= aux2_loop_spi;
                session_aux3_loop <= aux3_loop_spi;
                session_stream_mask <= stream_enable_spi;
                session_compute_output_enable_r <= compute_output_enable_spi;
                session_recording_output_enable_r <= recording_output_enable_spi;
                session_ttl_settle_enable <= ttl_settle_enable_spi;
                session_ttl_settle_input_index <= ttl_settle_input_index_spi;
                session_marker_mask <= marker_mask_spi;
                settle_frame_override <= 1'b0;
                // Preserve both the last commanded level and any edge that a
                // dummy-mode session could not send.  A real Aux1 overlay (or
                // reset) is the only event that clears the pending command.
            end else if (physical_transaction_active) begin
                if (spi_cycle == SPI_CYCLE_FIRST &&
                    engine_state == ENGINE_SCAN &&
                    scan_slot == SCAN_SLOT_FIRST_CHANNEL) begin
                    ttl_for_frame <= ttl_spi_sync;

                    // While enabled, own Reg0.D5 for the entire AUX1/2/3
                    // portion of this frame.  A control or input edge also
                    // queues an explicit Reg0 command for AUX1.
                    settle_frame_override <= settle_override_required;
                    if (settle_update_requested) begin
                        settle_level <= requested_settle_level;
                        settle_overlay_pending <= 1'b1;
                        settle_overlay_value <= requested_settle_level;
                    end
                    settle_control_enabled <= session_ttl_settle_enable;
                end

                // Four synchronous reads during the command before each AUX
                // slot.  read_data is captured one cycle after each address.
                if (engine_state == ENGINE_SCAN &&
                    spi_cycle >= AUX_ADDRESS_FIRST_CYCLE &&
                    spi_cycle <= AUX_ADDRESS_LAST_CYCLE) begin
                    case (scan_slot)
                        SCAN_SLOT_LAST_CHANNEL:
                            aux1_read_address <= {
                                session_aux1_banks[
                                    (spi_cycle-AUX_ADDRESS_FIRST_CYCLE)*2 +: 2],
                                aux1_index
                            };
                        SCAN_SLOT_AUX1:
                            aux2_read_address <= {
                                session_aux2_banks[
                                    (spi_cycle-AUX_ADDRESS_FIRST_CYCLE)*2 +: 2],
                                aux2_index
                            };
                        SCAN_SLOT_AUX2:
                            aux3_read_address <= {
                                session_aux3_banks[
                                    (spi_cycle-AUX_ADDRESS_FIRST_CYCLE)*2 +: 2],
                                aux3_index
                            };
                        default: ;
                    endcase
                end

                // read_address is registered in this block and read_data is
                // registered by intan_aux_command_ram on the following edge.
                // Capture it one edge later (two edges after assigning the
                // address) so connector A/B/C/D do not receive the preceding
                // connector's bank word.
                if (engine_state == ENGINE_SCAN &&
                    spi_cycle >= AUX_CAPTURE_FIRST_CYCLE &&
                    spi_cycle <= AUX_CAPTURE_LAST_CYCLE) begin
                    case (scan_slot)
                        SCAN_SLOT_LAST_CHANNEL:
                            aux1_prefetch[spi_cycle-AUX_CAPTURE_FIRST_CYCLE] <=
                                aux1_read_data;
                        SCAN_SLOT_AUX1:
                            aux2_prefetch[spi_cycle-AUX_CAPTURE_FIRST_CYCLE] <=
                                aux2_read_data;
                        SCAN_SLOT_AUX2:
                            aux3_prefetch[spi_cycle-AUX_CAPTURE_FIRST_CYCLE] <=
                                aux3_read_data;
                        default: ;
                    endcase
                end

                if (spi_cycle == SPI_CYCLE_LAST) begin
                    spi_cycle <= SPI_CYCLE_FIRST;

                    // The same decode drives cycle-0 MOSI above and loads the
                    // complete command here.  Keeping one source of truth
                    // prevents a hybrid transaction with a new bit 15 and
                    // stale bits 14..0 at the boundary.
                    if (next_transaction_valid) begin
                        current_command_a <= next_transaction_command_a;
                        current_command_b <= next_transaction_command_b;
                        current_command_c <= next_transaction_command_c;
                        current_command_d <= next_transaction_command_d;
                    end else begin
                        current_command_a <= 16'd0;
                        current_command_b <= 16'd0;
                        current_command_c <= 16'd0;
                        current_command_d <= 16'd0;
                    end

                    case (engine_state)
                        ENGINE_DRAIN_AUX2: begin
                            // First READ63 exposed AUX2; execute the second
                            // READ63 so the chip returns AUX3.
                            engine_state <= ENGINE_DRAIN_AUX3;
                        end

                        ENGINE_DRAIN_AUX3: begin
                            // Hold the final inactive-bus phase.  Wrapping the
                            // counter to zero while physical activity falls
                            // can otherwise create a zero-time CS-low glitch.
                            spi_cycle <= SPI_CYCLE_LAST;
                            engine_state <= ENGINE_FINALIZE;
                        end

                        ENGINE_SCAN: begin
                            if (scan_slot == SCAN_SLOT_AUX3) begin
                                aux3_index <= advance_aux_index(
                                    aux3_index,
                                    session_aux3_end,
                                    session_aux3_loop);

                                if (another_frame_requested) begin
                                    scan_slot <= SCAN_SLOT_FIRST_CHANNEL;
                                    frame_timestamp <= frame_timestamp + 32'd1;
                                end else begin
                                    engine_state <= ENGINE_DRAIN_AUX2;
                                end
                            end else if (scan_slot < SCAN_SLOT_AUX3) begin
                                scan_slot <= following_scan_slot;

                                if (scan_slot == SCAN_SLOT_AUX1) begin
                                    aux1_index <= advance_aux_index(
                                        aux1_index,
                                        session_aux1_end,
                                        session_aux1_loop);
                                    // Dummy mode did not send its slot-32
                                    // overlay, so retain it for a later real
                                    // acquisition session.
                                    if (!session_init_dummy_mode)
                                        settle_overlay_pending <= 1'b0;
                                end

                                if (scan_slot == SCAN_SLOT_AUX2)
                                    aux2_index <= advance_aux_index(
                                        aux2_index,
                                        session_aux2_end,
                                        session_aux2_loop);
                            end else begin
                                // Invalid slots cannot form a correctly timed
                                // drain transaction, so fail safe directly to
                                // the idle electrical state.
                                engine_state <= ENGINE_IDLE;
                                SPI_running <= 1'b0;
                            end
                        end

                        default: begin
                            engine_state <= ENGINE_IDLE;
                            SPI_running <= 1'b0;
                        end
                    endcase
                end else begin
                    spi_cycle <= next_spi_cycle;
                end
            end else if (engine_state == ENGINE_FINALIZE) begin
                // The second drain command captured AUX3.  No third physical
                // command is required; hand its tagged result to the formatter
                // while CS remains high.  Hold FINALIZE if backpressure is ever
                // introduced at this internal boundary.
                if (returning_reply_meta.reply_expected && reply_event_ready)
                    engine_state <= ENGINE_WAIT_OUTPUT;
            end else if (engine_state == ENGINE_WAIT_OUTPUT) begin
                if (formatter_final_reply_done) begin
                    acquisition_session_end <= 1'b1;
                    SPI_running <= 1'b0;
                    engine_state <= ENGINE_IDLE;
                end
            end
        end
    end

`ifndef SYNTHESIS
    // Core electrical invariants checked by every behavioral SPI test.
    always @(posedge spi_clk) begin
        if (!spi_reset && physical_transaction_active) begin
            assert (spi_cycle <= SPI_CYCLE_LAST);
            if (engine_state == ENGINE_SCAN)
                assert (scan_slot <= SCAN_SLOT_AUX3)
                    else $error("Invalid Intan scan slot");
            if (spi_cycle >= SPI_CS_DEASSERT_CYCLE)
                assert (CS && !SCLK);
            if (spi_cycle == SPI_CYCLE_FIRST &&
                returning_reply_meta.reply_expected)
                assert (reply_event_ready) else $error("Intan reply formatter overrun");
        end
    end
`endif
endmodule

`default_nettype wire
